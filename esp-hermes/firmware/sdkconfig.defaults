## esp-hermes/firmware/sdkconfig.defaults
```kconfig
# sdkconfig.defaults — ESP-Hermes firmware (ESP32-S3 / Stick S3)
# Stick S3: ESP32-S3-PICO-1-N8R8, 8MB Flash, 8MB PSRAM.

CONFIG_IDF_TARGET="esp32s3"

# --- Flash size (CRITICAL: Stick S3 has 8MB, default is 2MB) ---
CONFIG_PARTITION_TABLE_CUSTOM=y
CONFIG_PARTITION_TABLE_CUSTOM_FILENAME="partitions.csv"
# Flash size is a Kconfig *choice* — must set the bool symbol, not the string.
CONFIG_ESPTOOLPY_FLASHSIZE_8MB=y
# Keep the string in sync (derived from the choice above).
CONFIG_ESPTOOLPY_FLASHSIZE="8MB"

# --- PSRAM (Stick S3 PICO-1: embedded PSRAM currently fails to probe on this
#     unit; disable until line-mode sorted. Internal RAM used for framebuffers.) ---
# CONFIG_SPIRAM is intentionally OFF for now.
CONFIG_SPIRAM=n

# --- WebSocket over TLS (early bring-up: insecure behind tunnel) ---
# NOTE (spec §17): in production set this to n and pin the gateway cert.
CONFIG_ESP_TLS_INSECURE=y

# --- Main task stack (audio + WS + LCD coexist) ---
CONFIG_ESP_MAIN_TASK_STACK_SIZE=36864

# --- FreeRTOS ---
CONFIG_FREERTOS_HZ=1000
CONFIG_FREERTOS_UNICORE=n

# --- Logging (level is int: 0=NONE 1=ERROR 2=WARN 3=INFO 4=DEBUG) ---
CONFIG_LOG_DEFAULT_LEVEL=3
CONFIG_LOG_COLORS=y

# --- NVS ---
CONFIG_NVS_ENCRYPTION=n
```
